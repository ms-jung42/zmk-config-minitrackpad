## boards/shields/minitrackpad/Kconfig.defconfig
```kconfig
# Copyright (c) 2022 The ZMK Contributors
# SPDX-License-Identifier: MIT

if SHIELD_MINITRACKPAD

config ZMK_KEYBOARD_NAME
    default "MiniTrackpad"

endif
```

## config/west.yml
```yaml
manifest:
  defaults:
    revision: v0.3
  remotes:
    - name: zmkfirmware
      url-base: https://github.com/zmkfirmware
    - name: AYM1607
      url-base: https://github.com/AYM1607
    - name: TooManyLs
      url-base: https://github.com/TooManyLs
    # Additional modules containing boards/shields/custom code can be listed here as well
    # See https://docs.zephyrproject.org/3.2.0/develop/west/manifest.html#projects
  projects:
    - name: zmk
      remote: zmkfirmware
      import: app/west.yml
    - name: zmk-driver-azoteq-iqs5xx
      remote: TooManyLs
      revision: main
  self:
    path: config
```
