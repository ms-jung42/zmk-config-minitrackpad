## boards/shields/trackball/Kconfig.shield
```kconfig
# Copyright (c) 2022 The ZMK Contributors
# SPDX-License-Identifier: MIT

config SHIELD_TRACKBALL
    def_bool $(shields_list_contains,trackball)
```
